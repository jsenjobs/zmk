## app/src/mouse/Kconfig
```kconfig
# Copyright (c) 2021 The ZMK Contributors
# SPDX-License-Identifier: MIT

DT_COMPAT_ZMK_PS2_MOUSE := zmk,mouse-ps2

menuconfig ZMK_MOUSE
    bool "Enable ZMK mouse emulation"
    default n

config ZMK_MOUSE_TICK_DURATION
    int "Mouse tick duration in ms"
    default 8

if ZMK_MOUSE

choice ZMK_MOUSE_WORK_QUEUE
    prompt "Work queue selection for mouse events"
    default ZMK_MOUSE_WORK_QUEUE_DEDICATED

config ZMK_MOUSE_WORK_QUEUE_SYSTEM
    bool "Use default system work queue for mouse events"

config ZMK_MOUSE_WORK_QUEUE_DEDICATED
    bool "Use dedicated work queue for mouse events"

endchoice

if ZMK_MOUSE_WORK_QUEUE_DEDICATED

config ZMK_MOUSE_DEDICATED_THREAD_STACK_SIZE
    int "Stack size for dedicated mouse thread/queue"
    default 2048

config ZMK_MOUSE_DEDICATED_THREAD_PRIORITY
    int "Thread priority for dedicated mouse thread/queue"
    default 3

endif # ZMK_MOUSE_WORK_QUEUE_DEDICATED

endif

config ZMK_MOUSE_PS2
	bool
	default $(dt_compat_enabled,$(DT_COMPAT_ZMK_PS2_MOUSE))
    depends on (!ZMK_SPLIT || ZMK_SPLIT_ROLE_CENTRAL)
	select ZMK_MOUSE
    select PS2

if ZMK_MOUSE_PS2

config ZMK_MOUSE_PS2_SAMPLING_RATE
    int "Sets how many mouse activity reports should be sent per second. The default is 100. You can reduce this setting if you see a lot of PS/2 transmission errors. Increasing it will not lead to significant improvements, because mouse reports are accumulated and only sent over bluetooth every `CONFIG_ZMK_MOUSE_TICK_DURATION` ms."
	default 100

config ZMK_MOUSE_PS2_ENABLE_CLICKING
    bool "Enables clicking events."
	default y

config ZMK_MOUSE_PS2_INVERT_X
    bool "Invert the mouse movement x axis."
	default n

config ZMK_MOUSE_PS2_INVERT_Y
    bool "Invert the mouse movement y axis."
	default n

config ZMK_MOUSE_PS2_SWAP_XY
    bool "Swaps the X and Y axis."
	default n

config ZMK_MOUSE_PS2_SCROLL
    bool "Enable scroll wheel on mouse devices supporting the Intellimouse extension."
	default n

config ZMK_MOUSE_PS2_TP_TAP_TO_SELECT
    bool "Enables the ability to left-click by tapping the trackpoint."
	default n

config ZMK_MOUSE_PS2_TP_INVERT_X
    bool "Inverts x on the trackpoint. This is sets the setting directly in the trackpoint firmware and should therefore correctly impact the trackpoint algorithms."
	default n

config ZMK_MOUSE_PS2_TP_INVERT_Y
    bool "Inverts y on the trackpoint. This is sets the setting directly in the trackpoint firmware and should therefore correctly impact the trackpoint algorithms."
	default n

config ZMK_MOUSE_PS2_TP_SWAP_XY
    bool "Swaps the x and y axis on the trackpoint. This is sets the swap settingin the trackpoint firmware and should therefore correctly impact the trackpoint algorithms. But this setting is not supported by all trackpoints."
	default n

endif # ZMK_MOUSE_PS2
```
